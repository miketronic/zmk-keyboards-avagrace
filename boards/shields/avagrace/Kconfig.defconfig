## boards/shields/avagrace/Kconfig.defconfig
```kconfig
# Copyright (c) 2024 The ZMK Contributors
# SPDX-License-Identifier: MIT

if SHIELD_AVAGRACE
  
config ZMK_KEYBOARD_NAME
    default "Ava Grace"

endif
```

## boards/shields/avagrace/Kconfig.shield
```kconfig
# Copyright (c) 2024 The ZMK Contributors
# SPDX-License-Identifier: MIT

config SHIELD_AVAGRACE
    def_bool $(shields_list_contains,avagrace)
```
